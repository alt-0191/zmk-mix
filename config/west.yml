## config/west.yml
```yaml
manifest:
  defaults:
    revision: v0.3
  remotes:
  - name: zmkfirmware
    url-base: https://github.com/zmkfirmware/
  - name: phdesign
    url-base: https://github.com/ph-design/
  - name: mctechnology17
    url-base: https://github.com/mctechnology17

  projects:
  - name: zmk
    remote: phdesign
    revision: v0.3-lts
    import: app/west.yml
  - name: cirque-input-module
    url: https://github.com/petejohanson/cirque-input-module
    revision: main
    path: modules/cirque-input-module
  - name: zmk-nice-oled
    remote: mctechnology17
    revision: main
  self:
    path: config
```
